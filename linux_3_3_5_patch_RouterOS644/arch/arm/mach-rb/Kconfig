## linux_3_3_5_patch_RouterOS644/arch/arm/mach-rb/Kconfig
```kconfig
config ARCH_ALPINE
        bool "AnnapurnaLabs Alpine SOCs with Device Tree support"
	depends on ARCH_RB
        select ARCH_WANT_OPTIONAL_GPIOLIB
        select ARM_AMBA
		select SPARSE_IRQ
        select ARM_TIMER_SP804
        select ARM_L1_CACHE_SHIFT_6
        select CLKDEV_LOOKUP
        select GENERIC_CLOCKEVENTS
		select GENERIC_IRQ_CHIP
        select HAVE_CLK
        select HAVE_SMP
        select HAVE_SCHED_CLOCK
        select ARCH_SCHED_CLOCK
        select ICST
        select CPU_V7
        select ARM_GIC
        select HAVE_ARCH_TIMERS
        select COMMON_CLK
        select PCI
	select PCI_DOMAINS
        select ARCH_SUPPORTS_MSI
	select NEED_MACH_MEMORY_H
	select ARM_HAS_SG_CHAIN
	select USE_OF
        help
          This enables support for the AnnapurnaLabs SoC Gen1 boards.

config ARCH_QCOM
	bool "Qualcomm Support"
	depends on ARCH_RB
        select CPU_V7
	select ARCH_REQUIRE_GPIOLIB
	select ARM_GIC
	select ARM_AMBA
	select CLKSRC_OF
	select GENERIC_CLOCKEVENTS
	select HAVE_SMP
	select PINCTRL
	select ARCH_SUPPORTS_MSI
	select MIGHT_HAVE_PCI
	select PCI_DOMAINS if PCI
	select QCOM_SCM if SMP
	select HAVE_IRQ_TIME_ACCOUNTING
        select HAVE_SCHED_CLOCK
	select COMMON_CLK
        select CLKDEV_LOOKUP
	select HAVE_ARM_ARCH_TIMER
	help
	  Support for Qualcomm's devicetree based systems.

config ARCH_IPQ806X
	bool "IPQ806X support"
	select ARCH_MSM
	select HAVE_CLK
	select GENERIC_CLOCKEVENTS
	select ARCH_REQUIRE_GPIOLIB
	select ARCH_HAS_CPUFREQ
	select CLKDEV_LOOKUP
	select MSM_SMP
	select MSM_BUS_RPM_ARB_DISABLE
	select ARCH_MSM_KRAIT
	select HAVE_SCHED_CLOCK
	select MACH_IPQ806X_RB3011
	select HAVE_CLK_PREPARE
	select SWP_EMULATE
	select ARM_GIC
	select CPU_V7
	select PM
	select PCI
	select PCI_MSI
        select ARCH_SUPPORTS_MSI
	select MSM_PCIE
	select MSM_ADM3
	select MSM_V2_TLMM
	select MSM_GPIOMUX
	select MSM_RPM
	select USB_EHCI_MSM
	select MSM_SCM if SMP
	select QCOM_SCM if SMP
	select HAVE_SMP
	select SMP
	help
	  Support for Qualcomm's ipq806x.

config ARCH_IPQ40XX
	bool "IPQ40XX"
	select REGMAP_MMIO
	select PCI
	select PCI_MSI
	select QCOM_PCIE
	select MSM_PCIE
	select HAVE_CLK
	select HAVE_SCHED_CLOCK
	select HAVE_CLK_PREPARE
	select COMMON_CLK
	select ARCH_HAS_CPUFREQ
	select CPU_V7
	select MSM_V2_TLMM
	select ARCH_SUPPORTS_MSI
	select USB_EHCI_MSM
	select QCOM_SCM if SMP
	help
	  Support for ipq40XX

config ARCH_MVEBU
	bool "Marvell MSYS"
	select CLKSRC_MMIO
	select GENERIC_IRQ_CHIP
	select PINCTRL
	select PLAT_ORION
	select SOC_BUS
	select MVEBU_MBUS
	select ZONE_DMA if ARM_LPAE
	select ARCH_REQUIRE_GPIOLIB
	select PCI_QUIRKS if PCI
	select OF_ADDRESS_PCI
	select ARMADA_370_XP_TIMER
	select CACHE_L2X0
	select HAVE_SMP
	select CPU_PJ4B
	select MSYS_CLK
	select PINCTRL_MSYS
	help
	  Say 'Y' here if you want your kernel to support boards based
	  on the Marvell Msys SoC family with device tree.

if ARCH_QCOM
config QCOM_PCIE
	bool "QCOM PCIe Controller driver"

config SPS
	bool "SPS support"
	select GENERIC_ALLOCATOR
	help
	  The SPS (Smart Peripheral Switch) is a DMA engine.
	  It can move data in the following modes:
		1. Peripheral-to-Peripheral.
		2. Peripheral-to-Memory.
		3. Memory-to-Memory.
endif

if ARCH_IPQ806X

menu "IPQ806X Options"

config MSM_PCIE
	bool "MSM PCIe Controller driver"
	depends on PCI && PCI_MSI
	help
	  Enables the PCIe functionality by configures PCIe core on
	  MSM chipset and by enabling the ARM PCI framework extension.

config MSM_RPM
	bool "Resource Power Manager"
	select MSM_MPM

config MSM_BUS_SCALING
	bool "Bus scaling driver"
	default n

config MSM_BUS_RPM_ARB_DISABLE
	bool "Disables ARB request sent to RPM Firmware"
	depends on MSM_BUS_SCALING

config CPU_FREQ_MSM
        bool
        depends on CPU_FREQ && ARCH_MSM
        default y
        help
          This enables the CPUFreq driver for Qualcomm CPUs.
          If in doubt, say Y.

endmenu

config MSM_MPM
	bool

config MSM_GPIOMUX
	bool

config MSM_V2_TLMM
	bool

config MSM_ADM3
	bool

config MSM_SCM
	bool

config ARCH_MSM
	bool

config ARCH_MSM_KRAIT
	bool

config MSM_SMP
	bool

endif
```

## linux_3_3_5_patch_RouterOS644/arch/mips/rb/ralink/Kconfig
```kconfig
if RALINK_MT7621

choice
        prompt "Soc Hardware Type"
	default MT7621_ASIC

config  MT7621_ASIC 
	bool "MT7621-ASIC"
	select USB_ARCH_HAS_HCD
	select USB_ARCH_HAS_XHCI

endchoice


choice
       prompt "Flash Type"
       default MTD_ANY_RALINK

config MTD_SPI_RALINK
       bool "SPI"
       depends on  !RALINK_RT2880

config MTK_MTD_NAND
		bool "MTK_NAND"	
		depends on  RALINK_MT7621
		select MTD_NAND
		select MTD_NAND_IDS
		select MTD_NAND_ECC

config MTD_ANY_RALINK
       bool "ANY (NOR/SPI/NAND)"
       depends on  !RALINK_RT3352 && !RALINK_RT5350 && !RALINK_MT7628
		select MTD_NAND
		select MTD_NAND_IDS
		select MTD_NAND_ECC

endchoice


config  RALINK_RAM_SIZE
	int 
	default 256 if RALINK_MT7621

config MTD_PHYSMAP_START
       hex 
       default 0x1FC00000 if RALINK_MT7621

config MTD_PHYSMAP_LEN
       hex 
       default 0x1000000 if RALINK_MT7621

config MTD_PHYSMAP_BUSWIDTH
       int 
       default 2

config  RALINK_CPUSLEEP
	bool "Ralink CPU Sleep mode"
	select RALINK_SYSTICK
	default n

endif
```

## linux_3_3_5_patch_RouterOS644/arch/tile/drivers/Kconfig
```kconfig
config TILE_HPI
	bool "Tilera hypervisor HPI interface support"
	default y
	depends on !TILEGX
	---help---
	  This device provides access to HPI devices, typically via
	  "mem", "int", and "info" devices in /dev/hpi/.

config TILE_RSHIM
	bool "Access to the Tile chip's rshim counters"
	default y
	---help---
	  This device provides access to the Tile chip's rshim
	  "down counters", a simple external counter API,
	  typically via /dev/rshim.

config TILE_EEPROM
	bool "Access to the I2C EEPROM memory"
	default y
	---help---
	  This device provides access to the I2C EEPROM memory,
	  typically via /dev/eeprom/0.

config TILE_MEMPROF
	bool "Memory profiling support in /proc/tile/memprof"
	default y
	---help---
	  This device provides real-time information on memory utilization,
	  latency, etc.

config TILE_BME_MEM
	bool "Bare-Metal Environment memory-sharing interface"
	default y
	---help---
	  This device allows sharing memory between a BME application
	  running on some of the cores and Linux on other cores,
	  typically via /dev/bme/mem.

config TILE_SOFTUART
	bool "Tilera Soft UART"
	default n
	depends on !TILEGX
	---help---
	  This device provides access to the FlexIO UART functionality.
	  It requires a dedicated hypervisor "softuart" driver tile.

config TILE_NETIO
	tristate "TILEPro GBE/XGBE/PCIe character device support"
	default y
	depends on HUGETLBFS && !TILEGX
	---help---
	  This is the low-level driver for access to xgbe/gbe.
	  This is not a network driver; see drivers/net/tile/ for that.
	  Instead, it is used for raw network frame access from userspace.
	  It can also provide raw frame access to PCIe.

config TILE_TMFIFO
	tristate "Character-device access to the Tilera tile-monitor FIFO"
	default y
	depends on TILEGX
	---help---
	  This device supports communication with an external controller
	  via the tile-monitor FIFO hardware.

config TILE_USB
	tristate "Tilera USB host adapter support"
	default y
	depends on TILEGX && TILE_GXIO && TILE_GXIO_USB_HOST
	---help---
	  Provides USB host adapter support for the built-in EHCI and OHCI
	  interfaces on TILE-Gx chips.

config TILE_PKA
	tristate "Character-device access to the Tilera Public Key Accelerator"
	default y
	depends on TILEGX
	---help---
	  This device supports access to the hardware accelerator for
	  mathematical operations related to public key cryptography.
```

## linux_3_3_5_patch_RouterOS644/arch/tile/gxio/Kconfig
```kconfig
config TILE_GXIO
	bool "Tilera Gx I/O support"
	default y
	depends on TILEGX
	---help---
	  This option supports direct access to TILE-Gx hardware from
	  user space, via the gxio library, or from kernel space, via
	  kernel IORPC support.

config TILE_GXIO_DMA
	bool "Tilera Gx I/O DMA support"
	default y
	depends on TILE_GXIO
	---help---
	  This option supports direct access to the common I/O DMA facility
	  within the TILE-Gx mPIPE and Trio hardware.  It is not required
	  in order to use the gxio library to access mPIPE or Trio from
	  user space.

config TILE_GXIO_MPIPE
	bool "Tilera Gx mPIPE I/O support"
	default y
	depends on TILE_GXIO && TILE_GXIO_DMA
	---help---
	  This option supports direct access to the TILE-Gx mPIPE hardware
	  from kernel space.  It is not required in order to use the gxio
	  library to access mPIPE from user space.

config TILE_GXIO_GPIO
	bool "Tilera Gx GPIO I/O support"
	default y
	depends on TILE_GXIO
	---help---
	  This option supports direct access to the TILE-Gx GPIO hardware
	  from kernel space.  It is not required in order to use the gxio
	  library to access GPIO pins from user space.

config TILE_GXIO_TRIO
	bool "Tilera Gx TRIO I/O support"
	default y
	depends on TILE_GXIO && TILE_GXIO_DMA
	---help---
	  This option supports direct access to the TILE-Gx TRIO hardware
	  from kernel space.  It is not required in order to use the gxio
	  library to access TRIO from user space.

config TILE_GXIO_USB_HOST
	bool "Tilera Gx USB Host I/O support"
	default y
	depends on TILE_GXIO
	---help---
	  This option supports direct access to the TILE-Gx USB host adapter
	  hardware from kernel space.  It is required to use the Tilera USB
	  host driver.

config TILE_GXIO_PKA
	bool "Tilera Gx Public Key Accelerator support"
	default y
	depends on TILE_GXIO
	---help---
	  This option supports direct access to the TILE-Gx PKA hardware
	  from kernel space.

config TILE_GXIO_MICA
	bool "Tilera TILE-Gx Crypto Hardware Acceleration support"
	depends on TILEGX
	default y
	select TILE_GXIO
	---help---
	  This options supports direct access to the crypto acceleration
	  hardware from kernel space.

config TILE_GXIO_GXCR
	bool "Tilera TILE-Gx Crypto library support"
	depends on TILEGX
	default y
	select TILE_GXIO_MICA
	---help---
	  This options supports a mid-level API for access to the
	  Tilera TILE-Gx crypto accelerator engine from kernel space.

config TILE_GXIO_UART
	bool "Tilera TILE-Gx UART support"
	depends on TILEGX
	default y
	select TILE_GXIO
```

## linux_3_3_5_patch_RouterOS644/drivers/clocksource/Kconfig
```kconfig
config CLKSRC_OF
	bool

config CLKSRC_I8253
	bool

config CLKEVT_I8253
	bool

config I8253_LOCK
	bool

config CLKBLD_I8253
	def_bool y if CLKSRC_I8253 || CLKEVT_I8253 || I8253_LOCK

config CLKSRC_MMIO
	bool

config DW_APB_TIMER
	bool

config CLKSRC_DBX500_PRCMU
	bool "Clocksource PRCMU Timer"
	depends on UX500_SOC_DB5500 || UX500_SOC_DB8500
	default y
	help
	  Use the always on PRCMU Timer as clocksource

config CLKSRC_DBX500_PRCMU_SCHED_CLOCK
	bool "Clocksource PRCMU Timer sched_clock"
	depends on (CLKSRC_DBX500_PRCMU && !NOMADIK_MTU_SCHED_CLOCK)
	select HAVE_SCHED_CLOCK
	default y
	help
	  Use the always on PRCMU Timer as sched_clock

config ARM_ARCH_TIMER
	bool
	select CLKSRC_OF if OF

config ARM_ARCH_TIMER_EVTSTREAM
	bool "Support for ARM architected timer event stream generation"
	default y if ARM_ARCH_TIMER
	depends on ARM_ARCH_TIMER
	help
	  This option enables support for event stream generation based on
	  the ARM architected timer. It is used for waking up CPUs executing
	  the wfe instruction at a frequency represented as a power-of-2
	  divisor of the clock rate.
	  The main use of the event stream is wfe-based timeouts of userspace
	  locking implementations. It might also be useful for imposing timeout
	  on wfe to safeguard against any programming errors in case an expected
	  event is not generated.
	  This must be disabled for hardware validation purposes to detect any
	  hardware anomalies of missing events.
```
