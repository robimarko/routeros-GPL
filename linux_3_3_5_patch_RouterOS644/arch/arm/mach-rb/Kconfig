## linux_3_3_5_patch_RouterOS644/drivers/staging/fsl_qbman/Kconfig
```kconfig
config FSL_DPA
	bool "Freescale Datapath Queue and Buffer management"
	depends on HAS_FSL_QBMAN
	default y
	select FSL_QMAN_FQ_LOOKUP if PPC64

menu "Freescale Datapath QMan/BMan options"
	depends on FSL_DPA

config FSL_DPA_CHECKING
	bool "additional driver checking"
	default n
	---help---
	  Compiles in additional checks to sanity-check the drivers and any
	  use of it by other code. Not recommended for performance.

config FSL_DPA_CAN_WAIT
	bool
	default y

config FSL_DPA_CAN_WAIT_SYNC
	bool
	default y

config FSL_DPA_PIRQ_FAST
	bool
	default y

config FSL_DPA_PIRQ_SLOW
	bool
	default y

config FSL_DPA_PORTAL_SHARE
	bool
	default y

config FSL_DPA_UIO
	tristate "export USDPAA portals via UIO"
	depends on UIO
	default y
	---help---
	  Any portals unused by the kernel are exported as UIO devices for
	  use by USDPAA (User Space DataPath Acceleration Architecture)
	  applications.

config FSL_BMAN
	bool "Freescale Buffer Manager (BMan) support"
	default y

if FSL_BMAN

config FSL_BMAN_CONFIG
	bool "BMan device management"
	default y
	---help---
	  If this linux image is running natively, you need this option. If this
	  linux image is running as a guest OS under the hypervisor, only one
	  guest OS ("the control plane") needs this option.

config FSL_BMAN_TEST
	tristate "BMan self-tests"
	default n
	---help---
	  This option compiles self-test code for BMan.

config FSL_BMAN_TEST_HIGH
	bool "BMan high-level self-test"
	depends on FSL_BMAN_TEST
	default y
	---help---
	  This requires the presence of cpu-affine portals, and performs
	  high-level API testing with them (whichever portal(s) are affine to
	  the cpu(s) the test executes on).

config FSL_BMAN_TEST_THRESH
	bool "BMan threshold test"
	depends on FSL_BMAN_TEST
	default y
	---help---
	  Multi-threaded (SMP) test of BMan pool depletion. A pool is seeded
	  before multiple threads (one per cpu) create pool objects to track
	  depletion state changes. The pool is then drained to empty by a
	  "drainer" thread, and the other threads that they observe exactly
	  the depletion state changes that are expected.

config FSL_BMAN_DEBUGFS
	tristate "BMan debugfs interface"
	depends on DEBUG_FS
	default y
	---help---
	  This option compiles debugfs code for BMan.

endif # FSL_BMAN

config FSL_QMAN
	bool "Freescale Queue Manager (QMan) support"
	default y

if FSL_QMAN

config FSL_QMAN_BUG_AND_FEATURE_REV1
	bool "workarounds for errata and missing features in p4080 rev1"
	default y
	---help---
	  If this option is selected, the driver will be compiled with
	  workarounds for errata as well as feature limitations (relative to
	  more recent parts) of p4080 rev1. On unaffected revisions, this
	  support incurs only a negligable overhead, typically only a couple of
	  instructions per non-fast-path operation (the fast-path operations are
	  unaffected).

	  If in doubt, say Y.

config FSL_QMAN_POLL_LIMIT
	int
	default 32

config FSL_QMAN_CONFIG
	bool "QMan device management"
	default y
	---help---
	  If this linux image is running natively, you need this option. If this
	  linux image is running as a guest OS under the hypervisor, only one
	  guest OS ("the control plane") needs this option.

config FSL_QMAN_TEST
	tristate "QMan self-tests"
	default n
	---help---
	  This option compiles self-test code for QMan.

config FSL_QMAN_TEST_STASH_POTATO
	bool "QMan 'hot potato' data-stashing self-test"
	depends on FSL_QMAN_TEST
	default y
	---help---
	  This performs a "hot potato" style test enqueuing/dequeuing a frame
	  across a series of FQs scheduled to different portals (and cpus), with
	  DQRR, data and context stashing always on.

config FSL_QMAN_TEST_HIGH
	bool "QMan high-level self-test"
	depends on FSL_QMAN_TEST
	default y
	---help---
	  This requires the presence of cpu-affine portals, and performs
	  high-level API testing with them (whichever portal(s) are affine to
	  the cpu(s) the test executes on).

config FSL_QMAN_TEST_ERRATA
	bool "QMan errata-handling self-test"
	depends on FSL_QMAN_TEST
	default y
	---help---
	  This requires the presence of cpu-affine portals, and performs
	  testing that handling for known hardware-errata is correct.

config FSL_QMAN_DEBUGFS
	tristate "QMan debugfs interface"
	depends on DEBUG_FS
	default y
	---help---
	  This option compiles debugfs code for QMan.

# H/w settings that can be hard-coded for now.
config FSL_QMAN_FQD_SZ
	int "size of Frame Queue Descriptor region"
	default 9
	---help---
	  This is the size of the FQD region defined as: PAGE_SIZE * (2^value)
	  ex: 9 => PAGE_SIZE * (2^9)

# Corenet initiator settings. Stash request queues are 4-deep to match cores'
# ability to snart. Stash priority is 3, other priorities are 2.
config FSL_QMAN_CI_SCHED_CFG_SRCCIV
	int
	depends on FSL_QMAN_CONFIG
	default 4
config FSL_QMAN_CI_SCHED_CFG_SRQ_W
	int
	depends on FSL_QMAN_CONFIG
	default 3
config FSL_QMAN_CI_SCHED_CFG_RW_W
	int
	depends on FSL_QMAN_CONFIG
	default 2
config FSL_QMAN_CI_SCHED_CFG_BMAN_W
	int
	depends on FSL_QMAN_CONFIG
	default 2

# portal interrupt settings
config FSL_QMAN_PIRQ_DQRR_ITHRESH
	int
	default 12
config FSL_QMAN_PIRQ_MR_ITHRESH
	int
	default 4
config FSL_QMAN_PIRQ_IPERIOD
	int
	default 100

# 64 bit kernel support
config FSL_QMAN_FQ_LOOKUP
	bool
	default n

endif # FSL_QMAN

endmenu
```

## linux_3_3_5_patch_RouterOS644/drivers/thermal/Kconfig
```kconfig
#
# Generic thermal sysfs drivers configuration
#

menuconfig THERMAL
	tristate "Generic Thermal sysfs driver"
	help
	  Generic Thermal Sysfs driver offers a generic mechanism for
	  thermal management. Usually it's made up of one or more thermal
	  zone and cooling device.
	  Each thermal zone contains its own temperature, trip points,
	  cooling devices.
	  All platforms with ACPI thermal support can use this driver.
	  If you want this support, you should say Y or M here.

config THERMAL_HWMON
	bool
	depends on THERMAL
	depends on HWMON=y || HWMON=THERMAL
	default y

config AL_THERMAL
	bool "Annapurna Labs thermal sensor driver"
	depends on ARCH_ALPINE
	depends on OF
	help
	  Enable this to plug the Annapurna Labs thermal sensor driver into the
	  Linux thermal framework
```

## linux_3_3_5_patch_RouterOS644/fs/metafs/Kconfig
```kconfig
config META_FS
	depends on METAROUTER || MIPS_MIKROTIK
	tristate "MetaFS on Mikrotik MetaRouters"
```
